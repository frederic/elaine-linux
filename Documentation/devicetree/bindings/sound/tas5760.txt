## Documentation/devicetree/bindings/sound/tas5760.txt
```
Texas Instruments TAS5760 General purpose class-D amplifier.

The codec is controlled through and I2C interface. It also has an optional
speaker shutdown(SPK_SD) signal which can be wired to a GPIO.

Required properties:

- compatible: "ti, tas5760"
- reg : The I2C address of the device
- #sound-dai-cells: must be equal to 0

Optional properties:

- spk-sd-gpios: GPIO specifier for TAS5760's active low speaker shutdown line
- hw_params: subnode to specify the config parameters used for initialisation
  of chip. It consists of the following optional properties:
  	- pbtl-mode: selection for PBTL/BTL mode
	- pbtl-right-channel: channel selection for PBTL mode
	- volume-fading: enable/disable volume fading
	- digital-clip: value for adjusting digital clip level
	  range: (0 to 0xFFFFF)
	- digital-boost: digital gain of the amplifier
	  possible values(dB): 0,6,12,18
	- analog-gain: value for adjusting analog gain of the amplifier
	  possible values(0.1 dBV): 192, 226, 250
	- pwm-rate: control for pwm output swtching rate
	  range: (0 to 7)

Example:
	tas5760@06c {
		compatible: "ti,tas5760";
		reg = <0x6c>;
		#sound-dai-cells = <0>;

		spk-sd-gpios = <&gpio1 5 GPIO_ACTIVE_LOW>;

		hw_params {
			pbtl-mode;
			pbtl-right-channel;
			digital-clip = <0XFFFFF>;
			volume-fading;
			digital-boost = <6>;
			analog-gain = <192>;
			pwm-rate = <5>;
		};
	};
```

## drivers/amlogic/input/keyboard/Kconfig
```kconfig
#
# Kyeboard device configuration
#

menuconfig AMLOGIC_INPUT_KEYBOARD
	bool "Keyboards and keypads"
	default n
	help
	  Say Y here, and a list of supported keyboards and keypads will be displayed.
	  This option doesn't affect the kernel.

	  If unsure, say Y.

if AMLOGIC_INPUT_KEYBOARD

config AMLOGIC_ADC_KEYPADS
	tristate "Meson ADC keypad support"
	depends on AMLOGIC_SARADC
	default n
	help
	  Say Y here if you want to use the Meson ADC keypad.

config AMLOGIC_GPIO_KEY
	tristate "Amlogic gpio key device surport"
	default n
	help
	  Say Y here if you want to use the amlogic hold key.

if AMLOGIC_GPIO_KEY

config USE_VOL_UP_AND_DOWN_AS_FDR
	bool "Use volume up and down for fdr"
	default n
	help
	  Say Y here if you need to activate both buttons for factory reset.

endif # AMLOGIC_GPIO_KEY

config AMLOGIC_PCA9557_KEYPAD
        tristate "Amlogic pca9557 keypad device surport"
        default n
        help
          Say Y here if you want to use the amlogic hold key.

endif # AMLOGIC_INPUT_KEYBOARD
```

## drivers/amlogic/media_modules/Kconfig
```kconfig
menuconfig AMLOGIC_MEDIA_MODULES
	tristate "Amlogic Media Modules"
	default y
    help
		Amlogic audio video codec pipeline support.

if AMLOGIC_MEDIA_MODULES
config AMLOGIC_MEDIA_VDEC_MPEG12
	tristate "Amlogic MPEG video decoder"
	default y
    help
		This option is used to configure Amlogic media
		For mpeg1& mpeg2 decoder driver,
		if y this driver with build in.
		and m for build as modules.

config AMLOGIC_MEDIA_VDEC_MPEG4
	tristate "Amlogic MPEG4 video decoder"
	default y
    help
		This option is used to configure Amlogic media
		For mpeg4 decoder driver,
		if y this driver with build in.
		and m for build as modules.

config AMLOGIC_MEDIA_VDEC_MPEG4_MULTI
	tristate "Amlogic MPEG4 multi-instance video decoder"
	default n
    help
		This option is used to configure Amlogic media
		For mpeg4 multi instance decoder driver,
		if y this driver with build in.
		and m for build as modules.

config AMLOGIC_MEDIA_VDEC_VC1
	tristate "Amlogic VC1 video decoder"
	default y
    help
		This option is used to configure Amlogic media
		For vc1 decoder driver,
		if y this driver with build in.
		and m for build as modules.

config AMLOGIC_MEDIA_VDEC_H264
	tristate "Amlogic AVC video decoder"
	default y
    help
		This option is used to configure Amlogic media
		For avc/264 decoder driver,
		if y this driver with build in.
		and m for build as modules.

config AMLOGIC_MEDIA_VDEC_H264_MULTI
	tristate "Amlogic AVC multi-instance video decoder"
	default y
    help
		This option is used to configure Amlogic media
		For avc/264 multi instance decoder driver,
		if y this driver with build in.
		and m for build as modules.

config AMLOGIC_MEDIA_VDEC_H264_MVC
	tristate "Amlogic AVC MVC video decoder"
	default n
    help
		This option is used to configure Amlogic media
		For avc/264 mvc decoder driver,
		if y this driver with build in.
		and m for build as modules.

config AMLOGIC_MEDIA_VDEC_H265
	tristate "Amlogic HEVC video decoder"
	default y
    help
		This option is used to configure Amlogic media
		For hevc/265 decoder driver,
		if y this driver with build in.
		and m for build as modules.

config AMLOGIC_MEDIA_VDEC_VP9
	tristate "Amlogic VP9 video decoder"
	default y
    help
		This option is used to configure Amlogic media
		For vp9 decoder driver,
		if y this driver with build in.
		and m for build as modules.


config AMLOGIC_MEDIA_VDEC_MJPEG
	tristate "Amlogic Motion JPEG video decoder"
	default n
    help
		This option is used to configure Amlogic media
		For motion jpeg decoder driver,
		if y this driver with build in.
		and m for build as modules.

config AMLOGIC_MEDIA_VDEC_MJPEG_MULTI
	tristate "Amlogic Motion JPEG multi-instance video decoder"
	default n
    help
		This option is used to configure Amlogic media
		For motion jpeg multi instance decoder driver,
		if y this driver with build in.
		and m for build as modules.

config AMLOGIC_MEDIA_VDEC_REAL
	tristate "Amlogic Real Media video decoder"
	default n
    help
		This option is used to configure Amlogic media
		For real video decoder driver,
		if y this driver with build in.
		and m for build as modules.

config AMLOGIC_MEDIA_VDEC_AVS
	tristate "Amlogic AVS video decoder"
	default n
    help
		This option is used to configure Amlogic media
		For china AVS video decoder driver,
		if y this driver with build in.
		and m for build as modules.

config AMLOGIC_MEDIA_VDEC_YUV
       tristate "Amlogic YUV video decoder"
       select VIDEOBUF2_DMA_CONTIG
       default y
    help
               This option is used to configure Amlogic media
               For YUV SW decoder V4L2 driver,
               if y this driver with build in.
               and m for build as modules.

config AMLOGIC_MEDIA_VENC_H264
	tristate "Amlogic AVC video encoder"
	default n
    help
		This option is used to configure Amlogic media
		For 264 video encoder driver,
		if y this driver with build in.
		and m for build as modules.

config AMLOGIC_MEDIA_VENC_H265
	tristate "Amlogic HEVC video encoder"
	default n
    help
		This option is used to configure Amlogic media
		For 265 video encoder driver,
		if y this driver with build in.
		and m for build as modules.

endif
```

## drivers/amlogic/mtd/Kconfig
```kconfig
#
# Amlogic NAND device configuration
#

menu "Meson NAND Device Support"

config AMLOGIC_NAND
	bool "Meson NAND flash device"
	default n
	depends on MTD_BLOCK
	depends on MTD_NAND
	depends on MTD
	help
		Amlogic mtd support config.
		Support for MTD NAND flash on Amlogic Meson platforms
		Need open in defconfig, set CONFIG_AMLOGIC_NAND=y
		need check

config AML_NAND_RSV_DTB_ENV_KEY
	bool "Meson NAND RSV with DTB ENV KEY"
	default n
	depends on AMLOGIC_NAND
	help
		Amlogic nand driver config.
		Support rsv part without dtb env key.
		if use dtb env key in rsv,set AML_NAND_RSV_DTB_ENV_KEY=y
		otherwise, set it yes

config AML_NAND_SHORT_RSV
	bool "Meson NAND RSV hold 48 blocks or 8 blocks"
	default n
	depends on AMLOGIC_NAND
	help
		Amlogic nand driver config.
		define rsv part holding how many nand blocks.
		if want rsv part use 8 blocks,set AML_NAND_SHORT_RSV=y
		otherwise rsv part use 48 blocks.
endmenu
```

## drivers/amlogic/wifi/Kconfig
```kconfig
config AMLOGIC_WIFI
	bool "WiFi support"
	select WIRELESS_EXT
	select WEXT_PRIV
	default n
	help
		select y to support wifi

if AMLOGIC_WIFI
  source "../dhd-driver/bcmdhd.1.363.59.144.x.cn/Kconfig"
endif
```

## drivers/input/touchscreen/focaltech_touch_ft8201/Kconfig
```kconfig
#
# Focaltech Touchscreen driver configuration
#

config TOUCHSCREEN_FTS_8201
        bool "Focaltech Touchscreen FT8201"
		depends on I2C
		default n
		help
		  Say Y here if you have Focaltech FT8201 touch panel.
		  If unsure, say N.

config TOUCHSCREEN_FTS_8201_DIRECTORY
    string "Focaltech 8201 ts directory name"
    default "focaltech_touch_ft8201"
    depends on TOUCHSCREEN_FTS_8201
```

## drivers/input/touchscreen/goodix_touch/Kconfig
```kconfig
#
# Goodix Touchscreen driver configuration
#

config TOUCHSCREEN_GTS
        bool "Goodix Touchscreen"
		depends on I2C
		default n
		help
		  Say Y here if you have Goodix touch panel.
		  If unsure, say N.

config TOUCHSCREEN_GTS_DIRECTORY
    string "Goodix ts directory name"
    default "goodix_touch"
    depends on TOUCHSCREEN_GTS
```

## sound/soc/amlogic/auge/Kconfig
```kconfig
menuconfig AMLOGIC_SND_SOC_AUGE
	bool "Amlogic Auge ASoC"
	default n
	help
		Say Y or M if you want to add support for codecs attached to
		the Amlogic Asoc interface. You will also need
		to select the audio interfaces to support below.

if AMLOGIC_SND_SOC_MESON

config AUGE_PDM_TDM_SRC_CLK_HIGH_RATE
    depends on AMLOGIC_SND_SOC_AUGE
	bool "Amlogic Auge PDM TDM same src clk use high rate"
	default n
	help
	    Say Y if you want to make PDM TDM use use high rate.

endif # AMLOGIC_SND_SOC_MESON
```
