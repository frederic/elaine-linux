/*
 * arch/arm64/boot/dts/amlogic/puddy-p0.dts
 *
 * Copyright (C) 2019 Amlogic, Inc. All rights reserved.
 *
 * This program is free software; you can redistribute it and/or modify
 * it under the terms of the GNU General Public License as published by
 * the Free Software Foundation; either version 2 of the License, or
 * (at your option) any later version.
 *
 * This program is distributed in the hope that it will be useful, but WITHOUT
 * ANY WARRANTY; without even the implied warranty of MERCHANTABILITY or
 * FITNESS FOR A PARTICULAR PURPOSE.  See the GNU General Public License for
 * more details.
 *
 */

/dts-v1/;

#include "mesong12b.dtsi"
#include "puddy-panel.dtsi"
#include "mesong12a_drm.dtsi"
#include "puddy-common.dtsi"
#include "puddy-px-partition.dtsi"

&cpu_opp_table1 {
	opp10 {
		opp-hz = /bits/ 64 <1908000000>;
		opp-microvolt = <1022000>;
	};
};

&i2c_AO {
	accel: bma456@18 {
		status = "disable";
	};
};

/delete-node/ &temp_mlb;
/delete-node/ &temp_lmic;
/delete-node/ &temp_wifi;
/delete-node/ &temp_audio;
/delete-node/ &temp_soc;
/delete-node/ &temp_humidity;
